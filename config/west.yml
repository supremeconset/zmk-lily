## config/west.yml
```yaml
manifest:
  defaults:
    revision: v0.2.1
  remotes:
    - name: zmkfirmware
      url-base: https://github.com/zmkfirmware
    # - name: petejohanson
    #   url-base: https://github.com/petejohanson
  projects:
    - name: zmk
      remote: zmkfirmware
      import: app/west.yml
  self:
    path: config
```
